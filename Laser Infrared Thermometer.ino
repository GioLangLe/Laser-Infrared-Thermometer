// Sketch for Laser Infrared thermometer. Base Arduino
// 03/10/2019 by GioLangLe <giolangle@gmail.com> @ 18 Decor Workshop
// Project homepage: https://facebook.com/giolangle
// YouTube Channel : https://youtube.com/c/18DecorWorkshop
// Library LCD display here : https://github.com/GioLangLe/Adafruit_SH1106
///////////////////////////////////////////////////////////////////////////////////////
//Terms of use
///////////////////////////////////////////////////////////////////////////////////////
//THE SOFTWARE IS PROVIDED "AS IS", WITHOUT WARRANTY OF ANY KIND, EXPRESS OR
//IMPLIED, INCLUDING BUT NOT LIMITED TO THE WARRANTIES OF MERCHANTABILITY,
//FITNESS FOR A PARTICULAR PURPOSE AND NONINFRINGEMENT. IN NO EVENT SHALL THE
//AUTHORS OR COPYRIGHT HOLDERS BE LIABLE FOR ANY CLAIM, DAMAGES OR OTHER
//LIABILITY, WHETHER IN AN ACTION OF CONTRACT, TORT OR OTHERWISE, ARISING FROM,
//OUT OF OR IN CONNECTION WITH THE SOFTWARE OR THE USE OR OTHER DEALINGS IN
//THE SOFTWARE.
///////////////////////////////////////////////////////////////////////////////////////

#include "Wire.h"
#include <Adafruit_MLX90614.h>                     // For infrared thermometer
#include <Adafruit_GFX.h>                         // Include core graphics library for the display
#include <Adafruit_SH1106.h>                     // Include Adafruit_SH1106 library to drive the display
#include <Fonts/FreeMonoBold18pt7b.h>           // Add a custom font
//#include <Fonts/FreeMonoBold9pt7b.h>
Adafruit_MLX90614 mlx = Adafruit_MLX90614();  // For infrared thermometer
int temp;                                    // Create a variable to have something dynamic to show on the display
int press = 0;                              // Current state of the button
const int Laser_Pin = 9;                   // Laser Pin
const int buttonPin = 10;                 // Pushbutton pin

#define OLED_RESET 4
Adafruit_SH1106 display(OLED_RESET);
#if (SSD1306_LCDHEIGHT != 64)
// #error("Height incorrect, please fix Adafruit_SH1106.h!");
#endif
const unsigned char logo [] PROGMEM = {       // Display graphic

0x00, 0x00, 0x00, 0x00, 0xf8, 0x00, 0x00, 0x00, 0x00, 0x00, 0x00, 0x00, 0x00, 0x00, 0x00, 0x00, 
0x00, 0x00, 0x00, 0x07, 0xfe, 0x00, 0x00, 0x00, 0x00, 0x00, 0x00, 0x00, 0x00, 0x00, 0x00, 0x00, 
0x00, 0x00, 0x00, 0x0f, 0xff, 0x80, 0x00, 0x00, 0x00, 0x00, 0x00, 0x00, 0x00, 0x00, 0x00, 0x00, 
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0x00, 0x00, 0x00, 0x00, 0x00, 0x00, 0x00, 0x00, 0x00, 0x00, 0x00, 0x00, 0x00, 0x00, 0x00, 0x06,
};
void setup()
{
    //Serial.begin(9600);
    //Serial.println("MLX90614 Test"); 
    pinMode(Laser_Pin,OUTPUT);                            // Sets the pin as output
    pinMode(buttonPin, INPUT);                           // Sets the pin as intput
    display.begin(SH1106_SWITCHCAPVCC, 0x3C);           // Initialize display with the I2C address of 0x3C
    display.setTextColor(WHITE);                       // Set color of the text
    display.clearDisplay();                           // Clear the buffer
    display.drawBitmap(0, 0, logo, 128, 64, WHITE);  // Draw bitmap logo "18Decor".
    display.display();                              // Update display.
    delay(500);                                    // Delay to view bitmap logo. And this delay is needed to let the display to initialize
    mlx.begin();                                  // Start infrared thermometer
 }
void loop()
{
    press = digitalRead(buttonPin);
    //Serial.println(press);
    //Serial.print("Ambient = "); Serial.print(mlx.readAmbientTempC()); 
    //Serial.print("*C\tObject = "); Serial.print(mlx.readObjectTempC()); Serial.println("*C");
   // Check if the pushbutton is pressed. If it is, the buttonState is HIGH:
  if (press == HIGH) {
    // Turn Laser On
    digitalWrite(Laser_Pin, HIGH);
  temp++;                                      // Increase value for testing
  if (temp > 43)                              // If temp is greater than 150
  {
    temp = 0;                               // Set temp to 0
  }
  temp = mlx.readObjectTempC();
    display.clearDisplay();              // Clear the display so we can refresh
  // Print text:
    display.setFont();
    display.setCursor(45, 10);        // (x,y)
    display.println("TEMPERATURE");  // Text to print
  char string[10];
  // Print temperature and Convert float to a string:
  dtostrf(temp, 3, 0, string);             // (<variable>,<amount of digits we are going to use>,<amount of decimal digits>,<string name>)
    display.setFont(&FreeMonoBold18pt7b); // Set a custom font
    display.setCursor(20, 50);           // (x,y)
    display.println(string);            // Text to print
    display.setCursor(90, 50);         // (x,y)
    display.println("C");             // Text to print
    display.setCursor(77, 32);       // (x,y)
    display.println(".");           // Text or value to print
  // Draw a filled circle:
    display.fillCircle(18, 55, 7, WHITE);  // Draw filled circle (x,y,radius,color). X and Y are the coordinates for the center point
  // Draw rounded rectangle:
    display.drawRoundRect(16, 3, 5, 49, 2, WHITE);  // Draw rounded rectangle (x,y,width,height,radius,color)
  // It draws from the location to down-right
  // Draw ruler step
  for (int i = 6; i <= 45; i = i + 3) {
    display.drawLine(21, i, 22, i, WHITE);             // Draw line (x0,y0,x1,y1,color)
  }
  //Draw temperature
  temp = temp * 0.43; //ratio for show
    display.drawLine(18, 46, 18, 46 - temp, WHITE); // Draw line (x0,y0,x1,y1,color)
    display.display();                             // Print everything we set previously
    } else {
    // turn LED off:
    digitalWrite(Laser_Pin, LOW);
    display.clearDisplay();                           // Clear the buffer
    display.drawBitmap(0, 0, logo, 128, 64, WHITE);  // Draw bitmap logo "18Decor".
    display.display();                              // Update display.      
  }
    //Serial.println();
    delay(300);                                 // Delay for debounce
}
